## configs/wasm_defconfig
```kconfig
# WebAssembly build with Emscripten
CONFIG_BUILD_WASM=y
CONFIG_SYSTEM=y
CONFIG_ELF_LOADER=y
CONFIG_ESP32_C3=y
# CONFIG_LTO is not set
CONFIG_OPTIMIZE_LEVEL=3
CONFIG_BLOCK_CHAINING=y
```

## configs/wasmc6_defconfig
```kconfig
CONFIG_BUILD_WASM=y
CONFIG_RV32I=y
CONFIG_EXT_M=y
CONFIG_EXT_A=y
CONFIG_EXT_F=y
CONFIG_EXT_C=y
CONFIG_Zicsr=y
CONFIG_Zifencei=y
CONFIG_Zba=y
CONFIG_Zbb=y
CONFIG_Zbc=y
CONFIG_Zbs=y
CONFIG_INTERPRETER_ONLY=y
CONFIG_SYSTEM=y
CONFIG_MOP_FUSION=y
CONFIG_BLOCK_CHAINING=n
CONFIG_LTO=y
CONFIG_LOG_COLOR=y
CONFIG_OPTIMIZE_LEVEL=2
CONFIG_DEBUG_SYMBOLS=y
# CONFIG_SDL is not set
# CONFIG_SDL_MIXER is not set
CONFIG_ELF_LOADER=y
CONFIG_ESP32_C3=y
CONFIG_ESP32_C6=y
CONFIG_ESP32_H2=y
CONFIG_ESP32_P4=y
```
